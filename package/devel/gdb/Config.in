## package/devel/gdb/Config.in
```kconfig
choice
        prompt "GDB Version"
        depends on PACKAGE_gdb
        default GDB_VERSION_7_10_1
        help
          Select the version of GDB you wish to use.

        config GDB_VERSION_7_10_1
                bool "GDB 7.10.1"
        config GDB_VERSION_ANDROID_7_10
                bool "GDB Android 7.10"
        config GDB_VERSION_7_5
                bool "GDB 7.5"
endchoice
```

## target/linux/brcm63xx_ref_nand/Config.in
```kconfig
comment "Image naming"

config TARGET_MODEL_NAME
	string
	prompt "Model name + configuration"
	help
		First part of image name

config TARGET_VERSION
	string
	prompt "Model version"
	help
		Second part of image name
	
config TARGET_CUSTOMER
	string
	prompt "Customer ID"
	help
		A Customer id that is added to software file name

config TARGET_IBOARDID
	string
	prompt "Board ID"
	help
		4 letter id code used in the trailer or header to ensure the firmware to be flashed
		is for the correct board. This id is also used in the bcmkernel package to ensure
		that proper data tables are used when applicable. For example:
		D301 -> DG301
		VG50 -> VG50
		D201 -> DG201

config TARGET_CFERAM_EXT
	string
	prompt "cferam.xxx file extension"
	default "001"
	help
		The extension to use for the root FS /cferam.xxx file, e.g. "001"

config TARGET_NO_BLUETOOTH
	bool "Exclude Bluetooth"
	default n

config TARGET_NO_DECT
	bool "Exclude DECT"
	default n

config TARGET_NO_DHD
	bool "Exclude DHD"
	default n

config TARGET_NO_DSL
	bool "Exclude DSL"
	default n

config TARGET_NO_DSL_ANNEX_A
	bool "Exclude DSL Annex A"
	default n

config TARGET_NO_DSL_ANNEX_B
	bool "Exclude DSL Annex B"
	default n

config TARGET_NO_VOICE
	bool "Exclude Voice"
	default n
```
